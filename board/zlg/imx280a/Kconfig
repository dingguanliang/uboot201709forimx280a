## board/zlg/imx280a/Kconfig
```kconfig
if TARGET_IMX280A

config SYS_BOARD
	default "imx280a"

config SYS_VENDOR
	default "zlg"

config SYS_SOC
	default "mxs"

config SYS_CONFIG_NAME
	default "imx280a"

endif
```
